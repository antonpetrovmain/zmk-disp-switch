## dts/bindings/behaviors/zmk,behavior-disp-switch.yaml
```yaml
# Display on/off switch: blanks/unblanks the OLED via the Zephyr display API.
# No ext-power involvement — the controller stays powered (panel off ~= 10 uA)
# and initialized, so screens-on is instant and typing is never affected.
description: Display blanking switch behavior

compatible: "zmk,behavior-disp-switch"

include: one_param.yaml
```

## dts/bindings/behaviors/zmk,behavior-disp-ucost.yaml
```yaml
# Data-carrier behavior for daily model-cost sync across split halves.
description: Display cost sync behavior

compatible: "zmk,behavior-disp-ucost"

include: one_param.yaml
```

## dts/bindings/behaviors/zmk,behavior-disp-usync.yaml
```yaml
# Data-carrier behavior for Claude usage sync across split halves.
description: Display usage sync behavior

compatible: "zmk,behavior-disp-usync"

include: one_param.yaml
```
