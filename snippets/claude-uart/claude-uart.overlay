/* USB CDC-ACM serial for the Claude-usage OLED widget (central half only —
 * apply this snippet to corne_left in build.yaml). The Mac-side daemon writes
 * "CU:<0-100>\n" lines to /dev/tty.usbmodem*.
 *
 * REVERTED 2026-08-10: a second CDC-ACM endpoint for ZMK Studio's RPC was
 * added here, then removed with Studio itself — see the Studio incident note
 * in knowledge:corne-claude-usage-widget. Keeping ONE endpoint means the
 * daemon's /dev/cu.usbmodem* glob stays unambiguous. */
&zephyr_udc0 {
    cdc_acm_uart: cdc_acm_uart {
        compatible = "zephyr,cdc-acm-uart";
    };
};

/ {
    chosen {
        zmk,claude-uart = &cdc_acm_uart;
    };
};
